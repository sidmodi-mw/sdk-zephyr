## drivers/display/Kconfig.tn0xxx
```kconfig
# Copyright (c) 2023 Alen Daniel
# SPDX-License-Identifier: Apache-2.0

config TN0XXX
	bool "Kyocera TN0XXX memory display controller driver"
	default y
	depends on DT_HAS_KYO_TN0XXX_ENABLED
	select SPI
	help
	  Enable driver for kyocera memory in pixel tft display series TN0XXX

if TN0XXX

config TN0XXX_VERTICAL_BIT_MAPPING
	bool "TN0XXX uses bitmaps with bits aligned vertically"
	default n
	help
	  Initialize display in portrait orientation using bitmaps aligned vertically

config TN0XXX_ROTATED_180_DEGREE
	bool "TN0XXX display rotated 180 degrees and bits aligned vertically"
	default n
	help
	  Initialize display in portrait orientation using bitmaps aligned vertically,
	  except that the display orientation is flipped by 180 degrees

config TN0XXX_DIRTY_BUFFER
	bool "TN0XXX uses dirty buffer"
	default y
	help
	  Enable a second buffer to store the dirty area of the display which reduces the amount of data to be sent to the display

config TN0XXX_SHOW_UPDATE_RATE
	bool "TN0XXX show update rate"
	default n
	help
	  Show the update rate of the display in the kernel log

endif # TN0XXX
```
